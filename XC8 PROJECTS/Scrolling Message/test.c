#include <xc.h>
#include <string.h>
#include "pins.h"

// Define 74HC595 connections.
#define Serial_Data RC0
#define SH_Clk RC1
#define ST_Clk RC2

#pragma config OSC=HS, PWRT=OFF, BOR=OFF, WDT=OFF, LVP=OFF

void MY_DELAY(int ms);
void Send_Data(unsigned short row);

unsigned short Buffer[8][5] = {
                              {0,0,0,0,0},
                              {0,0,0,0,0},
                              {0,0,0,0,0},
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                              {0,0,0,0,0}
                             };
/*                                                          
unsigned short Buffer[8][5] = {
                              {0b10101010, 0b10101010, 0b10101010, 0b10101010, 0b10101010},
                              {0b00000000, 0b00000000, 0b00000000, 0b00000000, 0b00000000},
                              {0b00000000, 0b00000000, 0b00000000, 0b00000000, 0b00000000},
                              {0b00000000, 0b00000000, 0b00000000, 0b00000000, 0b00000000},
                              {0b00000000, 0b00000000, 0b00000000, 0b00000000, 0b00000000},
                              {0b00000000, 0b00000000, 0b00000000, 0b00000000, 0b00000000},
                              {0b00000000, 0b00000000, 0b00000000, 0b00000000, 0b00000000},
                              {0b00000000, 0b00000000, 0b00000000, 0b00000000, 0b00000000}
                             };
   CharData is a two dimensional constant array that holds the 8-bit column values for individual rows. ASCII characters on a 8x8 matrix format.
*/

const unsigned short CharData[][8] ={
{0b00000000, 0b00000000, 0b00000000, 0b00000000, 0b00000000, 0b00000000, 0b00000000, 0b00000000},
{0b00000100, 0b00000100, 0b00000100, 0b00000100, 0b00000100, 0b00000100, 0b00000000, 0b00000100},
{0b00001010, 0b00001010, 0b00001010, 0b00000000, 0b00000000, 0b00000000, 0b00000000, 0b00000000},
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{0b00000000, 0b00000000, 0b00000000, 0b00001010, 0b00011110, 0b00010100, 0b00000000, 0b00000000}
};

void main()
   {
      ADCON1 = 0x06; //ALL DIGITAL
      
      TRISA = 0x00;	//ALL OUTPUTS
      TRISB = 0x00;  //ALL OUTPUTS
      TRISC = 0x00;	//ALL OUTPUTS
      TRISE = 0x00;  //ALL OUTPUTS
      TRISD = 0x00;
      PORTD = 0x00;
      PORTC = 0x00;
      PORTB = 0x00;
      
      unsigned short index, i, l, k, m, row, scroll, temp, Shift_Step=1, StringLength, speed;
      int a;
      const unsigned char default_message[]="NITIN";
      StringLength = strlen(default_message);
      
      for(i = 0; i <= 5; i++)
         {
            LED = 0xFF;
            MY_DELAY(1000);  //1SEC DELAY
            LED = 0x00;
            MY_DELAY(1000);  //1SEC DELAY
         }
      i = 0;  //Reset 
      
      //do 
         //{
            for (k=0; k<StringLength; k++)
               {
                  for (scroll=0; scroll<(8/Shift_Step); scroll++) 
                     {
                        /*
                           Display buffer has 8 rows and 5 bytes. Update it one by one row.
                        */
                        
                        for (row=0; row<8; row++)
                           {
                              index = default_message[k];
                              temp = CharData[index-32][row];
                              Buffer[row][4] = (Buffer[row][4] << Shift_Step) | (Buffer[row][3] >> (8-Shift_Step));
                              Buffer[row][3] = (Buffer[row][3] << Shift_Step) | (Buffer[row][2] >> (8-Shift_Step));
                              Buffer[row][2] = (Buffer[row][2] << Shift_Step) | (Buffer[row][1] >> (8-Shift_Step));
                              Buffer[row][1] = (Buffer[row][1] << Shift_Step) | (Buffer[row][0] >> (8-Shift_Step));
                              Buffer[row][0] = (Buffer[row][0] << Shift_Step)| (temp >> ((8-Shift_Step)-scroll*Shift_Step));
                           }
                        //Send buffer to display one row at a time.
                        speed = 5;
                        for(l=0; l<speed;l++)
                           {
                              m = 1;
                              for (i=0; i<8; i++)
                                 {
                                    Send_Data(i);
                                    ROWS = m;
                                    m = m << 1;
                                    _delay(1);  //1SEC DELAY
                                 }  // i
                           } // l
                     } // scroll
               } // k
         //} while(1);
         /*
         Send_Data(0);
         ROWS = 1;
         */
         while(1)
            {
               for(a=0; a<100; a++)
                  {
                     m = 1;
                     for (i=0; i<8; i++)
                        {
                           Send_Data(i);
                           ROWS = m;
                           m = m << 1;
                           _delay(1);  //1SEC DELAY
                        }  // i
                  }
               m = 0;
               MY_DELAY(1000);
            } 
   }   
   
void MY_DELAY(int ms)
   {
      while(ms > 0)
         {
            __delay_ms(1);
            ms--;
         }
      return;
   }         
   
void Send_Data(unsigned short row)
   {
      unsigned short Mask, bits, column, Flag;
      PORTC = 0x00;
      //Each row has 5 bytes
      for (column = 0; column < 5; column++) 
         {
            //Each byte has 8 bits.
            Mask = 0x01;
            for (bits=0; bits<8; bits++)
               {
                  //Flag = bits % 2;
                  Flag = Buffer[row][column] & Mask;
                  if(Flag == 0) 
                     {
                        Serial_Data = 0;
                        _delay(1);  //1SEC DELAY
                        SH_Clk = 1;
                        _delay(1);  //1SEC DELAY
                        SH_Clk = 0;
                     }   
                  if(Flag > 0) 
                     {
                        Serial_Data = 1;
                        _delay(1);  //1SEC DELAY
                        SH_Clk = 1;
                        _delay(1);  //1SEC DELAY
                        SH_Clk = 0;
                     }   
                  Mask = Mask << 1;
               }
         }
      // Apply clock on ST_Clk
      ST_Clk = 1;
      _delay(1);  //1SEC DELAY
      ST_Clk = 0;
   }
